## base_external/Config.in
```kconfig
source "$BR2_EXTERNAL_project_base_PATH/package/led/Config.in"
source "$BR2_EXTERNAL_project_base_PATH/package/switch/Config.in"
source "$BR2_EXTERNAL_project_base_PATH/package/ledSwitch/Config.in"
source "$BR2_EXTERNAL_project_base_PATH/package/dcmotor/Config.in"
source "$BR2_EXTERNAL_project_base_PATH/package/motorSwitch/Config.in"
source "$BR2_EXTERNAL_project_base_PATH/package/aesdDriver/Config.in"
```

## base_external/package/aesdDriver/Config.in
```kconfig
config BR2_PACKAGE_AESDDRIVER
	bool "AESDDRIVER"
	help
	  Includes the executable, scripts in the kernel image.
	  Used to include aesd driver.
```

## base_external/package/dcmotor/Config.in
```kconfig
config BR2_PACKAGE_DCMOTOR
	bool "DCMOTOR"
	help
	  Includes the executable, scripts in the kernel image.
	  Used to interface BBB pins with DC motors.
```

## base_external/package/led/Config.in
```kconfig
config BR2_PACKAGE_LED
	bool "LED"
	help
	  Includes the executable, scripts in the kernel image.
	  Used to interface BBB pins with LED.
```

## base_external/package/ledSwitch/Config.in
```kconfig
config BR2_PACKAGE_LEDSWITCH
	bool "LEDSWITCH"
	help
	  Includes the executable, scripts in the kernel image.
	  Used to interface BBB pins with led and push button switch.
```

## base_external/package/motorSwitch/Config.in
```kconfig
config BR2_PACKAGE_MOTORSWITCH
	bool "MOTORSWITCH"
	help
	  Includes the executable, scripts in the kernel image.
	  Used to interface BBB pins with DC motors that are controlled by external switches.
```

## base_external/package/switch/Config.in
```kconfig
config BR2_PACKAGE_SWITCH
	bool "SWITCH"
	help
	  Includes the executable, scripts in the kernel image.
	  Used to interface BBB pins with push button switch.
```
